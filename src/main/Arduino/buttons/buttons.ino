char recv = '0'; //переменная для приема и отправки сообщений
char lastRecv = '0'; //дополнительная переменная для хранения предыдущего значения recv
byte buttonPress = HIGH; // переменная для определения нажата кнопка или нет, HIGH – не нажата
long time; // переменная для таймера
void setup() {
  pinMode(13, OUTPUT); //настраиваем пин для встроенного светодиода
  pinMode(8, INPUT_PULLUP); //настраиваем пин для кнопки
  digitalWrite(13, LOW); //гасим светодиод на всякий случай
  Serial.begin(9600); //задаем скорость порта
  time = millis(); //стартуем таймер
}
void loop() {
//  if (Serial.available() > 0) { //если есть данные для приема из ком-порта
//    recv = Serial.read(); //считываем 1 символ в переменную recv
//  } //можно использовать Serial.readString() для чтения строк
  buttonPress = digitalRead(8); //считываем значение пина с кнопкой
  //если кнопка нажата и с прошлого нажатия прошло не менее 500 мс
  if (buttonPress == LOW && millis() - time > 500) {
    recv = (recv == '0') ? '1' : '0'; //то меняем значение переменной recv
    time = millis(); //и сбрасываем таймер
  }
  if (recv == '1') { //в зависимости от значения переменной recv
    digitalWrite(13, HIGH); //либо включаем светодиод
  }
  else {
    digitalWrite(13, LOW); //либо выключаем светодиод

  } //это можно сделать и одной строчкой
  // (recv == '1') ? digitalWrite(13, HIGH) : digitalWrite(13, LOW);
  if (lastRecv != recv) { //и если предыдущее значение recv отличается от текущего
    //Serial.print("recv="); //то отправляем в ком-порт строку со значением переменной
    Serial.print(recv);
    lastRecv = recv; //и делаем одинаковыми lastRecv и recv
  } //такая конструкция нужна, чтобы отправить данные в порт 1 раз, а не постоянно
}
